/* source key position labels */

#include "zmk-helpers/key-labels/totem.h"
// work

#define X_LB    &kp LEFT
#define X_RB    &tog NAV

#define X_LH    &kp LEFT
#define X_RH    &kp RIGHT

/* activate bluetooth */
#define CONFIG_WIRELESS 1

/* source the main keymap */
#include "base.keymap"

